## configs/zynq_motion_defconfig
```kconfig
# 修改记录
# 日期          修改人          描述
# 20160306      刘旭升          feat: 支持zynq-motion项目

CONFIG_ARM=y
CONFIG_ARCH_ZYNQ=y
CONFIG_TARGET_ZYNQ_MOTION=y
CONFIG_DEFAULT_DEVICE_TREE="zynq-motion"
# CONFIG_SYS_MALLOC_F is not set
# CONFIG_SPL is not set
CONFIG_FIT=y
CONFIG_FIT_VERBOSE=y
CONFIG_FIT_SIGNATURE=y
# CONFIG_CMD_IMLS is not set
# CONFIG_CMD_FLASH is not set
# CONFIG_CMD_SETEXPR is not set
CONFIG_OF_EMBED=y
```
