/*
 * Xilinx Zynq Motion board DTS
 *
 * Copyright (C) 2013 Xilinx, Inc.
 *
 * SPDX-License-Identifier:	GPL-2.0+
 *
 * 修改记录
 * 日期          修改人          描述
 * 20160306      刘旭升          feat: 支持zynq-motion项目
 */
/dts-v1/;
#include "zynq-7000.dtsi"

/ {
	model = "Zynq Motion Board";
	compatible = "xlnx,zynq-motion", "xlnx,zynq-7000";

	aliases {
		serial0 = &uart1;
	};

	memory {
		device_type = "memory";
		reg = <0 0x20000000>;
	};
};
